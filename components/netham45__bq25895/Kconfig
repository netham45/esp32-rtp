## components/netham45__bq25895/Kconfig
```kconfig
menu "Power: BQ25895"
    config BQ25895_I2C_ADDR
        hex "BQ25895 I2C address"
        default 0x6A

    config BQ25895_I2C_PORT
        int "I2C port number"
        range 0 1
        default 0

    config BQ25895_SDA_GPIO
        int "I2C SDA GPIO"
        default 8

    config BQ25895_SCL_GPIO
        int "I2C SCL GPIO"
        default 9

    config BQ25895_I2C_FREQ_HZ
        int "I2C frequency (Hz)"
        default 100000

    config BQ25895_OTG_GPIO
        int "OTG control GPIO"
        default 13

    config BQ25895_DEFAULT_BOOST_MV
        int "Default boost voltage (mV)"
        default 5000
endmenu
```

## components/netham45__ntp/Kconfig
```kconfig
menu "NTP / DNS"
    config DNS_MDNS_PORT
        int "mDNS UDP port"
        default 5353

    config DNS_MDNS_IPV4_ADDRESS
        string "mDNS multicast IPv4 address"
        default "224.0.0.251"

    config NTP_SERVER_PORT
        int "NTP server port"
        default 123

    config NTP_QUERY_TARGET
        string "NTP/DNS query target (hostname)"
        default "screamrouter.local"

    config NTP_HISTORY_SIZE
        int "NTP history size"
        default 25

    config NTP_POLL_INTERVAL_MS
        int "NTP poll interval (ms)"
        default 500

    config NTP_FAST_POLL_INTERVAL_MS
        int "NTP fast poll interval (ms)"
        default 50

    config NTP_MAX_FAILURE_COUNT
        int "Max consecutive failures before cache invalidation"
        default 3
endmenu
```

## components/netham45__usb_host_uac/Kconfig
```kconfig
menu "USB Host UAC"
    config UAC_PRINTF_CONFIGURATION_DESCRIPTOR
        bool "Print UAC Configuration Descriptor"
        default n
        help
            Print UAC Configuration Descriptor to console.
    config UAC_DEV_ADDR_LIST_MAX
        int "Max USB Device Address List"
        default 6
        help
            Max USB Device Address List to find the UAC device. If more devices are connected.
            The driver will only use the first UAC_DEV_ADDR_LIST_MAX devices.
    config UAC_FREQ_NUM_MAX
        int "Max Number of Frequencies each Alt-interface supports"
        default 4
        help
            Max Number of Frequencies each Alt-interface supports. If the device supports more frequencies,
            the driver will only use the first UAC_FREQ_NUM_MAX frequencies.
    config UAC_NUM_ISOC_URBS
        int "Number of UAC ISOC URBs"
        default 3
        help
            Number of UAC ISOC URBs to use. Fewer URBs could cause audio dropouts.
            More URBs will increase the RAM usage.
    config UAC_NUM_PACKETS_PER_URB
        int "Number of Packets per UAC ISOC URB"
        default 3
        help
            Number of Packets per UAC ISOC URB. It limits the minimum packets each transfer will send.
    config UAC_RINGBUF_SAFE_DELETE_WAITING_MS
        int "Ringbuf Safe Delete Waiting Time in ms"
        default 50
        help
            Ringbuf Safe Delay Time in ms. It is used to wait for the ringbuf to be untouched before deleting it.
endmenu # "USB Host UAC"
```

## components/netham45__usb_in/Kconfig
```kconfig
menu "USB In"

config USB_IN_SAMPLE_RATE
    int "USB input sample rate (Hz)"
    default 48000
    help
        Sample rate for audio frames received from the host.

config USB_IN_CHANNEL_COUNT
    int "USB input channel count"
    default 2
    range 1 8
    help
        Number of PCM channels delivered over USB audio.

config USB_IN_BIT_DEPTH
    int "USB input bit depth"
    default 16
    range 8 32
    help
        Bits per PCM sample; must be divisible by 8.

config USB_IN_CHUNK_SIZE
    int "USB transfer chunk size (bytes)"
    default 1152
    help
        Number of bytes read per USB isochronous transfer.

config USB_IN_BUFFER_SIZE
    int "USB internal buffer size (bytes)"
    default 2304
    help
        Size of the internal staging buffer before data is written to the PCM ring buffer.

config USB_IN_PCM_BUFFER_SIZE
    int "PCM ring buffer size (bytes)"
    default 8192
    help
        Capacity of the FreeRTOS ring buffer storing PCM audio.

config USB_IN_TASK_STACK_SIZE
    int "USB audio task stack size (bytes)"
    default 4096
    help
        Stack size for the USB audio monitoring task.

config USB_IN_TASK_PRIORITY
    int "USB audio task priority"
    default 5
    range 0 25
    help
        Priority assigned to the USB audio monitoring task.

endmenu
```

## components/netham45__usb_out/Kconfig
```kconfig
menu "USB Out"
    config USB_HOST_TASK_PRIO
        int "USB host task priority"
        default 5

    config USB_HOST_TASK_STACK
        int "USB host task stack size"
        default 4096

    config UAC_TASK_PRIO
        int "UAC task priority"
        default 5

    config UAC_TASK_STACK
        int "UAC task stack size"
        default 4096

    config USB_ENUMERATION_TIMEOUT_MS
        int "USB enumeration timeout (ms)"
        default 5000

    config USB_TRANSFER_RETRY_COUNT
        int "USB transfer retry count"
        default 3

    config USB_TRANSFER_RETRY_DELAY_MS
        int "USB transfer initial retry delay (ms)"
        default 100

    config USB_RECONNECT_DELAY_MS
        int "USB reconnect base delay (ms)"
        default 2000

    config USB_RECONNECT_MAX_ATTEMPTS
        int "USB reconnect max attempts"
        default 5

    config USB_INIT_MAX_RETRIES
        int "USB host init max retries"
        default 3
endmenu
```

## components/netham45__usb_out/components/espressif__usb_host_uac/Kconfig
```kconfig
menu "USB Host UAC"
    config PRINTF_UAC_CONFIGURATION_DESCRIPTOR
        bool "Print UAC Configuration Descriptor"
        default n
        help
            Print UAC Configuration Descriptor to console.
    config UAC_FREQ_NUM_MAX
        int "Max Number of Frequencies each Alt-interface supports"
        default 4
        help
            Max Number of Frequencies each Alt-interface supports. If the device supports more frequencies,
            the driver will only use the first UAC_FREQ_NUM_MAX frequencies.
    config UAC_NUM_ISOC_URBS
        int "Number of UAC ISOC URBs"
        default 3
        help
            Number of UAC ISOC URBs to use. Fewer URBs could cause audio dropouts.
            More URBs will increase the RAM usage.
    config UAC_NUM_PACKETS_PER_URB
        int "Number of Packets per UAC ISOC URB"
        default 3
        help
            Number of Packets per UAC ISOC URB. It limits the minimum packets each transfer will send.
endmenu # "USB Host UAC"
```

## components/netham45__visualizer/Kconfig
```kconfig
menu "Visualizer"

    config VIZ_CHUNK_SIZE
        int "Visualizer chunk size (bytes)"
        default 1152

    config VIZ_RING_SIZE
        int "Visualizer ring size (bytes)"
        default 4608

    config VIZ_WINDOW_SIZE
        int "Visualizer RMS window size (samples)"
        default 1024

    config VIZ_ATTACK_COEFF_MPCT
        int "Attack coefficient (milli-percent, 1000=1.0)"
        default 200

    config VIZ_RELEASE_COEFF_MPCT
        int "Release coefficient (milli-percent, 1000=1.0)"
        default 30

    config VIZ_PEAK_HOLD_MS
        int "Peak hold (ms)"
        default 1500

    config VIZ_PPM_MIN_DB_TENTHS
        int "PPM min dB (tenths)"
        default -400

    config VIZ_PPM_MAX_DB_TENTHS
        int "PPM max dB (tenths)"
        default 0

    config VIZ_PPM_DB_RANGE_TENTHS
        int "PPM dB range (tenths)"
        default 400

    config VIZ_PPM_OVERLOAD_DB_TENTHS
        int "PPM overload threshold dB (tenths)"
        default -30

    config VIZ_PPM_DECAY_DB_PER_SEC_TENTHS
        int "PPM decay dB/s (tenths)"
        default 250

    config VIZ_SMOOTH_COEFF_MPCT
        int "Smoothing coefficient (milli-percent, 1000=1.0)"
        default 300

    config VIZ_AUTO_GAIN_MIN_MPCT
        int "Auto-gain min (milli-percent)"
        default 500

    config VIZ_AUTO_GAIN_MAX_MPCT
        int "Auto-gain max (milli-percent)"
        default 4000

    config VIZ_AUTO_GAIN_TARGET_MPCT
        int "Auto-gain target (milli-percent)"
        default 800

    config VIZ_AUTO_GAIN_ADJUST_RATE_MPCT
        int "Auto-gain adjust rate per second (milli-percent)"
        default 50

    config VIZ_AUTO_GAIN_WINDOW_MS
        int "Auto-gain window (ms)"
        default 1000
endmenu
```

## main/Kconfig.projbuild
```kconfig
menu "ESP32-RTP Configuration"

menu "Core Audio"
config SAMPLE_RATE
    int "Default sample rate (Hz)"
    default 48000
    help
        Sample rate used for audio processing and RTP timestamp calculations.
endmenu

menu "Networking (RTP/SAP)"
config RTP_PORT
    int "RTP UDP port"
    range 1024 65535
    default 4010
    help
        UDP port for receiving RTP audio streams.
        
config SAP_PORT
    int "SAP port"
    default 9875
    help
        Port for SAP (Session Announcement Protocol) announcements.
        
config SAP_MULTICAST_ADDR
    string "SAP multicast IPv4 address"
    default "224.2.127.254"
    help
        Multicast address for SAP announcements.
endmenu

menu "RTCP Configuration"
config RTCP_ENABLED
    bool "Enable RTCP support"
    default y
    help
        Enable RTCP (RTP Control Protocol) for media synchronization.
        RTCP provides timing information from RTP senders and statistics
        about the quality of reception.

config RTCP_TARGET_LATENCY_MS
    int "Target playout latency (ms)"
    default 50
    range 10 500
    depends on RTCP_ENABLED
    help
        Target latency for synchronized audio playout.
        Lower values reduce delay but may cause dropouts.
        Higher values increase buffering and stability.

config RTCP_LOG_SYNC_INFO
    bool "Log RTCP synchronization info"
    default n
    depends on RTCP_ENABLED
    help
        Enable logging of RTCP synchronization information.
        This includes clock offset and playout timing details.
        Useful for debugging but may be verbose.

config RTCP_SEND_RR
    bool "Send RTCP Receiver Reports"
    default y
    depends on RTCP_ENABLED
    help
        Send RTCP Receiver Reports (RR) back to the sender.
        These reports contain reception statistics that help
        the sender adapt to network conditions.
endmenu

endmenu
```

## sdkconfig.defaults
```kconfig
# The mDNS component is now added as a dependency in idf_component.yml

# Partition Table Configuration
CONFIG_PARTITION_TABLE_CUSTOM=y
CONFIG_PARTITION_TABLE_CUSTOM_FILENAME="partitions.csv"

# USB-C Power Management Configuration
CONFIG_I2C_MASTER_SCL_IO=9
CONFIG_I2C_MASTER_SDA_IO=8
CONFIG_OTG_PIN=13
CONFIG_I2C_MASTER_FREQ_HZ=100000
CONFIG_POWER_CHIP_ADDR=0x6B
CONFIG_ENABLE_OTG_BOOST_MODE=y
CONFIG_BOOST_VOLTAGE_VALUE=0x93
CONFIG_BOOST_FREQUENCY_VALUE=0x38

# ----------------------------
# ESP32-RTP project defaults
# ----------------------------

# Core Audio
CONFIG_PCM_CHUNK_SIZE=1152
CONFIG_SAMPLE_RATE=48000
CONFIG_BIT_DEPTH=16
CONFIG_DEFAULT_VOLUME_PCT=100

# Networking (RTP/SAP)
CONFIG_RTP_PORT=4010
CONFIG_SAP_PORT=9875
CONFIG_SAP_MULTICAST_ADDR="224.2.127.254"
CONFIG_SAP_PULSEAUDIO_ADDR="224.0.0.56"
CONFIG_SAP_MAX_ANNOUNCEMENTS=10
CONFIG_SAP_ANNOUNCEMENT_TIMEOUT_SEC=120
CONFIG_SAP_CLEANUP_INTERVAL_SEC=30
CONFIG_SAP_BUFFER_SIZE=1024

# Power: BQ25895
CONFIG_BQ25895_I2C_ADDR=0x6A
CONFIG_BQ25895_I2C_PORT=0
CONFIG_BQ25895_SDA_GPIO=8
CONFIG_BQ25895_SCL_GPIO=9
CONFIG_BQ25895_I2C_FREQ_HZ=100000
CONFIG_BQ25895_OTG_GPIO=13
CONFIG_BQ25895_DEFAULT_BOOST_MV=5000

# Feature Gates
CONFIG_FEATURE_USB=y
CONFIG_FEATURE_SPDIF=y

# USB Out
CONFIG_USB_HOST_TASK_PRIO=5
CONFIG_USB_HOST_TASK_STACK=4096
CONFIG_UAC_TASK_PRIO=5
CONFIG_UAC_TASK_STACK=4096
CONFIG_USB_ENUMERATION_TIMEOUT_MS=5000
CONFIG_USB_TRANSFER_RETRY_COUNT=3
CONFIG_USB_TRANSFER_RETRY_DELAY_MS=100
CONFIG_USB_RECONNECT_DELAY_MS=2000
CONFIG_USB_RECONNECT_MAX_ATTEMPTS=5
CONFIG_USB_INIT_MAX_RETRIES=3

# SPDIF In
CONFIG_SPDIF_IN_RMT_RESOLUTION_HZ=80000000
CONFIG_SPDIF_IN_RMT_MEM_BLOCK_SYMBOLS=8192
CONFIG_SPDIF_IN_SYMBOL_BUFFER_SIZE=8192
CONFIG_SPDIF_IN_PCM_BUFFER_SIZE=4096
CONFIG_SPDIF_IN_DECODER_TASK_STACK=4096
CONFIG_SPDIF_IN_DECODER_TASK_PRIORITY=10
CONFIG_SPDIF_IN_HISTOGRAM_BIN_COUNT=256
CONFIG_SPDIF_IN_MAX_PULSE_WIDTH_NS=2000
CONFIG_SPDIF_IN_MIN_SAMPLES_FOR_ANALYSIS=10000
CONFIG_SPDIF_IN_PULSE_RATIO_TOLERANCE_MILLIPCT=150
CONFIG_SPDIF_IN_EXPECTED_SHORT_PULSE_PCT_TENTHS=600
CONFIG_SPDIF_IN_EXPECTED_MEDIUM_PULSE_PCT_TENTHS=350
CONFIG_SPDIF_IN_EXPECTED_LONG_PULSE_PCT_TENTHS=50
CONFIG_SPDIF_IN_DISTRIBUTION_TOLERANCE_PCT=100

# mDNS Discovery
CONFIG_MDNS_QUERY_TIMEOUT_MS=3000
CONFIG_MDNS_MAX_RESULTS=10
CONFIG_MDNS_MAX_DEVICES=16

# NTP / DNS
CONFIG_DNS_MDNS_PORT=5353
CONFIG_DNS_MDNS_IPV4_ADDRESS="224.0.0.251"
CONFIG_NTP_SERVER_PORT=123
CONFIG_NTP_QUERY_TARGET="screamrouter.local"
CONFIG_NTP_HISTORY_SIZE=25
CONFIG_NTP_POLL_INTERVAL_MS=500
CONFIG_NTP_FAST_POLL_INTERVAL_MS=50
CONFIG_NTP_MAX_FAILURE_COUNT=3

# WiFi
CONFIG_WIFI_AP_CHANNEL=1
CONFIG_WIFI_AP_MAX_CONNECTIONS=4
CONFIG_WIFI_CONNECTION_TIMEOUT_MS=10000

# Visualizer (fixed-point where needed)
CONFIG_VIZ_CHUNK_SIZE=1152
CONFIG_VIZ_RING_SIZE=4608
CONFIG_VIZ_WINDOW_SIZE=1024
CONFIG_VIZ_ATTACK_COEFF_MPCT=200
CONFIG_VIZ_RELEASE_COEFF_MPCT=30
CONFIG_VIZ_PEAK_HOLD_MS=1500
CONFIG_VIZ_PPM_MIN_DB_TENTHS=-400
CONFIG_VIZ_PPM_MAX_DB_TENTHS=0
CONFIG_VIZ_PPM_DB_RANGE_TENTHS=400
CONFIG_VIZ_PPM_OVERLOAD_DB_TENTHS=-30
CONFIG_VIZ_PPM_DECAY_DB_PER_SEC_TENTHS=250
CONFIG_VIZ_SMOOTH_COEFF_MPCT=300
CONFIG_VIZ_AUTO_GAIN_MIN_MPCT=500
CONFIG_VIZ_AUTO_GAIN_MAX_MPCT=4000
CONFIG_VIZ_AUTO_GAIN_TARGET_MPCT=800
CONFIG_VIZ_AUTO_GAIN_ADJUST_RATE_MPCT=50
CONFIG_VIZ_AUTO_GAIN_WINDOW_MS=1000
```
